## components/opensource/linux/linux-2.6.36/fs/hfsplus_journal/Kconfig
```kconfig
config HFSPLUS_JOURNAL_FS
	tristate "HFSPLUS filesystem with journal support"
	select NLS
	select NLS_UTF8
	help
		Enabling journal support in HFSPlus file system.
```
